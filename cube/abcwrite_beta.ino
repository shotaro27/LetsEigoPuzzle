#define SCL_PIN  5
#define SCL_PORT PORTB
#define SDA_PIN  4
#define SDA_PORT PORTB
#include <SoftWire.h>
#define ADDRESS 0x50
SoftWire Wire = SoftWire();
#include <avr/pgmspace.h>
#define LCD_CS A3
#define LCD_CD A2
#define LCD_WR A1
#define LCD_RD A0

#define LCD_RESET A4

#define BLACK   0x0000
#define BLUE    0x001F
#define RED     0xF800
#define GREEN   0x07E0
#define CYAN    0x07FF
#define MAGENTA 0xF81F
#define YELLOW  0xFFE0
#define WHITE   0xFFFF
#include <MCUFRIEND_kbv.h>
MCUFRIEND_kbv tft;

const PROGMEM uint16_t A[] = {
  35647, 63, 256, 65, 255, 65, 255, 65, 254, 67, 253, 67,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 57,
  33636
};

const PROGMEM uint16_t B[] = {
  35642, 142, 170, 150, 165, 155, 161, 159, 157, 163, 154, 166,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 122,
  33656
};

const PROGMEM uint16_t C[] = {
  33106, 28, 283, 45, 270, 56, 259, 65, 251, 73, 243, 80,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 12,
  31833
};

const PROGMEM uint16_t D[] = {
  35340, 130, 182, 138, 176, 144, 172, 148, 168, 152, 165, 155,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 121,
  33970
};

const PROGMEM uint16_t E[] = {
  33986, 193, 127, 193, 127, 193, 127, 193, 127, 193, 127, 193,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 199,
  35261
};

const PROGMEM uint16_t F[] = {
  34625, 188, 132, 188, 132, 188, 132, 188, 132, 188, 132, 188,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 55,
  34627
};

const PROGMEM uint16_t G[] = {
  32779, 30, 282, 47, 267, 59, 256, 68, 247, 78, 239, 84,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 12,
  32152
};

const PROGMEM uint16_t H[] = {
  34933, 53, 104, 54, 109, 53, 104, 54, 109, 53, 104, 54,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 54,
  34296
};

const PROGMEM uint16_t I[] = {
  35012, 54, 266, 54, 266, 54, 266, 54, 266, 54, 266, 54,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 54,
  34374
};

const PROGMEM uint16_t J[] = {
  34635, 55, 265, 55, 265, 55, 265, 55, 265, 55, 265, 55,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 27,
  32790
};

const PROGMEM uint16_t K[] = {
  34288, 69, 101, 55, 96, 69, 100, 55, 97, 69, 99, 55,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 55,
  34927
};

const PROGMEM uint16_t L[] = {
  35082, 55, 265, 55, 265, 55, 265, 55, 265, 55, 265, 55,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 186,
  34303
};

const PROGMEM uint16_t M[] = {
  34911, 78, 96, 80, 66, 78, 96, 80, 66, 79, 95, 80,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 51,
  34275
};

const PROGMEM uint16_t N[] = {
  34612, 51, 106, 57, 106, 51, 105, 58, 106, 51, 105, 58,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 51,
  34614
};

const PROGMEM uint16_t O[] = {
  32465, 26, 286, 42, 272, 54, 261, 64, 252, 72, 245, 78,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 12,
  32476
};

const PROGMEM uint16_t P[] = {
  34690, 133, 180, 140, 175, 145, 171, 149, 168, 152, 165, 155,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 55,
  34617
};

const PROGMEM uint16_t Q[] = {
  32467, 26, 286, 42, 272, 54, 261, 64, 252, 72, 245, 78,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 2,
  29057
};

const PROGMEM uint16_t R[] = {
  34684, 147, 166, 154, 161, 159, 157, 163, 153, 167, 150, 170,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 54,
  34609
};

const PROGMEM uint16_t S[] = {
  32470, 31, 280, 49, 265, 61, 255, 70, 246, 78, 238, 86,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 14,
  32475
};

const PROGMEM uint16_t T[] = {
  34613, 214, 106, 214, 106, 214, 106, 214, 106, 214, 106, 214,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 55,
  34692
};

const PROGMEM uint16_t U[] = {
  34613, 54, 102, 55, 109, 54, 102, 55, 109, 54, 102, 55,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 14,
  32474
};

const PROGMEM uint16_t V[] = {
  34603, 56, 115, 58, 92, 55, 115, 58, 92, 55, 115, 58,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 52,
  34696
};

const PROGMEM uint16_t W[] = {
  34569, 50, 74, 52, 72, 52, 21, 49, 74, 52, 72, 52,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 46,
  34638
};

const PROGMEM uint16_t X[] = {
  35567, 62, 95, 65, 99, 61, 95, 64, 101, 61, 93, 65,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 63,
  33646
};

const PROGMEM uint16_t Y[] = {
  35566, 60, 107, 64, 89, 60, 107, 64, 90, 60, 106, 63,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 55,
  33733
};

const PROGMEM uint16_t Z[] = {
  35577, 202, 118, 202, 118, 202, 118, 202, 118, 202, 118, 202,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 205,
  33658
};

const PROGMEM uint16_t star[] = {
  36639, 1, 319, 1, 318, 2, 318, 3, 317, 3, 316, 4,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 1,
  36879
};

int abc[27] = {849, 789, 749, 877, 529, 529, 917, 967, 529, 663, 975, 529, 1829, 1275, 929, 685, 1039, 879, 723, 529, 993, 929, 1715, 881, 759, 529, 621};
int idx[] = {0, 849, 1638, 2387, 3264, 3793, 4322, 5239, 6206, 6735, 7398, 8373, 8902, 10731, 12006, 12935, 13620, 14659, 15538, 16261, 16790, 17783, 18712, 20427, 21308, 22067, 22596};

void writebyte(unsigned long address, byte data)  {
  uint8_t   dddr = (uint8_t)ADDRESS | (uint8_t)(address >> 16);
  uint16_t  addr = address;
  Wire.beginTransmission(dddr);
  Wire.write((byte)(addr >> 8));
  Wire.write((byte)(addr & 0xFF));
  Wire.write(data);
  Wire.endTransmission();
  delay(6);
}

void write2byte(unsigned long addr, word data) {
  writebyte(addr, data);
  writebyte(addr + 1, data >> 8);
}

byte readbyte(unsigned long address)  {
  uint8_t   dddr = (uint8_t)ADDRESS | (uint8_t)(address >> 16);
  uint16_t  addr = address & 0xFFFF;
  byte data = 0xFF;
  Wire.beginTransmission(dddr);
  Wire.write((byte)(addr >> 8));
  Wire.write((byte)(addr & 0xFF));
  Wire.endTransmission();
  Wire.requestFrom(dddr, (uint8_t)1);
  data = Wire.read();
  return data;
}

word read2byte(unsigned long addr) {
  return readbyte(addr) + (readbyte(addr + 1) << 8);
}

void readdata(char addr) {
  byte ad = addr - 65;
  for (int i = 0; i < abc[ad]; i++) {
    //    Serial.println((unsigned long)idx[ad] * 2 + i * 2);
    Serial.println(read2byte((unsigned long)idx[ad] * 2 + i * 2));
  }
}

void setup() {
  Serial.begin(115200);
  Serial.println(F("TFT LCD test"));
  //ディスプレイ初期化
  tft.reset();

  uint16_t identifier = tft.readID();
  if (identifier == 0x9325) {
    Serial.println(F("Found ILI9325 LCD driver"));
  } else if (identifier == 0x9328) {
    Serial.println(F("Found ILI9328 LCD driver"));
  } else if (identifier == 0x4535) {
    Serial.println(F("Found LGDP4535 LCD driver"));
  } else if (identifier == 0x7575) {
    Serial.println(F("Found HX8347G LCD driver"));
  } else if (identifier == 0x9341) {
    Serial.println(F("Found ILI9341 LCD driver"));
  } else if (identifier == 0x7783) {
    Serial.println(F("Found ST7781 LCD driver"));
  } else if (identifier == 0x8230) {
    Serial.println(F("Found UC8230 LCD driver"));
  }
  else if (identifier == 0x8357) {
    Serial.println(F("Found HX8357D LCD driver"));
  } else if (identifier == 0x0101)
  {
    identifier = 0x9341;
    Serial.println(F("Found 0x9341 LCD driver"));
  } else if (identifier == 0x9481)
  {
    Serial.println(F("Found 0x9481 LCD driver"));
  }
  else if (identifier == 0x9486)
  {
    Serial.println(F("Found 0x9486 LCD driver"));
  }
  else {
    Serial.print(F("Unknown LCD driver chip: "));
    Serial.println(identifier, HEX);
    Serial.println(F("If using the Adafruit 2.8\" TFT Arduino shield, the line:"));
    Serial.println(F("  #define USE_ADAFRUIT_SHIELD_PINOUT"));
    Serial.println(F("should appear in the library header (Adafruit_TFT.h)."));
    Serial.println(F("If using the breakout board, it should NOT be #defined!"));
    Serial.println(F("Also if using the breakout, double-check that all wiring"));
    Serial.println(F("matches the tutorial."));
    identifier = 0x9486;

  }
  tft.begin(identifier);
  tft.fillScreen(BLUE);
  Serial.print("TFT size is "); Serial.print(tft.width()); Serial.print("x"); Serial.println(tft.height());
  Wire.begin();
  writedata('[');
  readdata('[');
  displayed('[');
}

void writedata(char dataaddr) {
  unsigned long ad = dataaddr - 65;
  for (int ofs = 0; ofs < abc[ad]; ofs++) {
    write2byte((unsigned long)idx[ad] * 2 + ofs * 2, pgm_read_word_near(star + ofs));
  }
  Serial.print(read2byte((unsigned long)idx[ad] * 2));
}

word readData(byte index, int offset) {
  byte ad = index - 65;
  return read2byte((unsigned long)idx[ad] * 2 + offset * 2);
}

void displayed(byte data) {
  tft.fillScreen(BLUE);
  int index = 0;
  unsigned int t = 0;
  bool c = false;
  unsigned int data2byte = readData(data, index);
  for (int i = 0; i < 480; i++) {
    for (int j = 0; j < 320; j++) {
      //Serial.print(t);
      if (t == data2byte) {
        index++;
        c = !c;
        t = 0;
        Serial.println(data2byte);
        data2byte = readData(data, index);
      }
      if (c) {
        tft.drawPixel(320 - j, i, WHITE);
      }
      t++;
    }
  }
}
void loop() {}
